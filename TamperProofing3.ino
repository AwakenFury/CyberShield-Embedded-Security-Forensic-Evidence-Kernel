

#include <WiFi.h>
#include <DNSServer.h>
#include <WebServer.h>
#include <esp_partition.h>
#include <esp_ota_ops.h>
#include <esp_heap_caps.h>

// --- Core Internal ESP32 Temp Engine ---
#ifdef __cplusplus
extern "C" {
#endif
uint8_t temprature_sens_read(); 
#ifdef __cplusplus
}
#endif

// --- Configuration Settings ---
// const char* AP_SSID = "ESP32_Secure_Node";
const char* AP_SSID = "UPDATED_SKETCH_SLOTB";
const char* AP_PASS = "FactorySecure123!"; 
const byte DNS_PORT = 53;
const char* ROLLBACK_PASSWORD = "AdminSuperSecretKey2026";
const float MAX_SAFE_TEMP = 80.0; 

// Capture macro constants generated by compiler on machine upload
const char* SKETCH_COMPILE_DATE = __DATE__;
const char* SKETCH_COMPILE_TIME = __TIME__;

struct SystemSnapshot {
  uint8_t partition_hash[32];
  volatile uint32_t magnetic_tamper_count;
  bool is_compromised;
  String attack_reason;
};

SystemSnapshot baseline;
DNSServer dnsServer;
WebServer server(80);

WiFiClient streamClient;
bool isStreamActive = false;








// --- Advanced Forensic Mapping Web UI Layout ---
const char DASHBOARD_HTML[] PROGMEM = R"=====(
<!DOCTYPE html>
<html lang="en">
<head>
    <meta charset="UTF-8"><meta name="viewport" content="width=device-width, initial-scale=1.0">
    <title>ESP32 Advanced Forensic Console</title>
    <style>
        :root { --bg-main: #0f172a; --bg-card: #1e293b; --text-main: #f8fafc; --text-muted: #94a3b8; --border: #334155; --bg-input: #0f172a; --accent: #3b82f6; }
        body { font-family: -apple-system, sans-serif; background: var(--bg-main); color: var(--text-main); padding: 20px; margin: 0; }
        .container { max-width: 800px; margin: 0 auto; }
        .grid { display: grid; grid-template-columns: 1fr 1fr; gap: 15px; }
        @media(max-width:768px){ .grid { grid-template-columns: 1fr; } }
        .card { background: var(--bg-card); padding: 20px; border-radius: 8px; margin-bottom: 15px; border: 1px solid var(--border); }
        .status-box { padding: 12px; border-radius: 6px; font-weight: bold; text-align: center; font-size: 18px; }
        .status-good { background: #065f46; color: #34d399; }
        .status-bad { background: #991b1b; color: #f87171; animation: pulse 1.5s infinite; }
        .metric-row { display: flex; justify-content: space-between; padding: 10px 0; border-bottom: 1px solid var(--border); }
        .metric-label { color: var(--text-muted); }
        .metric-value { font-family: monospace; font-weight: bold; }
        .btn { display: block; width: 100%; background: var(--accent); color: white; border: none; padding: 12px; border-radius: 6px; font-weight: bold; cursor: pointer; text-align: center; margin-top: 15px; box-sizing: border-box; text-decoration: none; }
        .btn-warn { background: #dc2626; margin-top: 10px; }
        .btn-sec { background: #475569; margin-top: 10px; }
        .input-field { width: 100%; padding: 10px; border-radius: 6px; border: 1px solid var(--border); background: var(--bg-input); color: var(--text-main); margin-top: 5px; margin-bottom: 10px; box-sizing: border-box; }
        .terminal { background: #020617; border: 1px solid var(--border); border-radius: 6px; padding: 10px; font-family: monospace; font-size: 12px; height: 160px; overflow-y: auto; color: #38bdf8; white-space: pre-wrap; box-sizing: border-box; }
        table { width: 100%; border-collapse: collapse; margin-top: 10px; font-family: monospace; font-size: 12px; }
        th, td { text-align: left; padding: 8px; border-bottom: 1px solid var(--border); }
        th { color: var(--text-muted); }
        @keyframes pulse { 0% { opacity: 1; } 50% { opacity: 0.5; } 100% { opacity: 1; } }
    </style>
</head>
<body>
    <div class="container">
        <div class="card"><div id="statusAlert" class="status-box status-good">AWAITING SYSTEM SYNCHRONIZATION...</div></div>
        
        <div class="card">
            <h3>📑 Active Running Firmware Snapshot</h3>
            <div class="metric-row"><span class="metric-label">Global Compile Timestamp</span><span id="firmwareTimestamp" style="color:#60a5fa;" class="metric-value">--</span></div>
            <div class="metric-row"><span class="metric-label">Active Flash Location</span><span id="partVal" class="metric-value">--</span></div>
            <div class="metric-row"><span class="metric-label">SHA-256 Sign Fingerprint</span><span id="hashVal" class="metric-value">--</span></div>
        </div>

        <div class="card">
            <h3>🗂️ Flash Hardware Partition Allocation Map</h3>
            <table>
                <thead><tr><th>Partition Slot</th><th>Address Block</th><th>Status Allocation</th></tr></thead>
                <tbody>
                    <tr><td>ota_0 (Slot A)</td><td>0x10000</td><td id="slotA_State">Scanning...</td></tr>
                    <tr><td>ota_1 (Slot B)</td><td>0x1D0000</td><td id="slotB_State">Scanning...</td></tr>
                </tbody>
            </table>
            <div style="display:flex; gap:10px;">
                <a href="/api/export-csv" class="btn btn-sec" style="font-size:12px; padding:8px;">📥 Export Allocation Log (.CSV)</a>
                <button class="btn btn-sec" style="font-size:12px; padding:8px;" onclick="window.print()">🖨️ Snapshot Screen View</button>
            </div>
        </div>

        <div class="grid">
            <div class="card">
                <h3>🌡️ Telemetry Channels</h3>
                <div class="metric-row"><span class="metric-label">Internal Core Temp</span><span id="tempVal" class="metric-value" style="color:#ef4444;">-- °C</span></div>
                <div class="metric-row"><span class="metric-label">Free Dynamic RAM</span><span id="ramVal" class="metric-value">-- bytes</span></div>
                <div class="metric-row"><span class="metric-label">Active Radio Connections</span><span id="connVal" class="metric-value">--</span></div>
            </div>
            <div class="card">
                <h3>🔄 Partition Management</h3>
                <label class="metric-label" for="passKey">Emergency Recovery Pin</label>
                <input type="password" id="passKey" class="input-field" placeholder="Verification code...">
                <button class="btn btn-warn" style="padding:8px; margin:0;" onclick="triggerRollback()">Force Firmware Rollback</button>
            </div>
        </div>
        
        <div class="card">
            <h3>📡 Stream Output Logs</h3>
            <div id="logTerminal" class="terminal">Hooking stream vectors...</div>
        </div>
    </div>
    <script>
        const eventSource = new EventSource('/stream');

        eventSource.onmessage = function(event) {
            let data = JSON.parse(event.data);
            
            document.getElementById('firmwareTimestamp').innerText = data.compile_date + " @ " + data.compile_time;
            document.getElementById('partVal').innerText = data.partition + " (Running)";
            document.getElementById('hashVal').innerText = data.hash.substring(0, 24) + "...";
            
            if(data.partition === "ota_0") {
                document.getElementById('slotA_State').innerHTML = "<b style='color:#34d399;'>ACTIVE APPLICATION</b>";
                document.getElementById('slotB_State').innerHTML = "<span style='color:#94a3b8;'>ROLLBACK FALLBACK TARGET</span>";
            } else {
                document.getElementById('slotA_State').innerHTML = "<span style='color:#94a3b8;'>ROLLBACK FALLBACK TARGET</span>";
                document.getElementById('slotB_State').innerHTML = "<b style='color:#34d399;'>ACTIVE APPLICATION</b>";
            }

            document.getElementById('tempVal').innerText = data.temp.toFixed(1) + " °C";
            document.getElementById('ramVal').innerText = data.free_ram.toLocaleString() + " bytes";
            document.getElementById('connVal').innerText = data.connections;
            
            const alertBox = document.getElementById('statusAlert');
            if (data.compromised) {
                alertBox.innerText = "🚨 CRITICAL STATE: " + data.reason;
                alertBox.className = "status-box status-bad";
            } else {
                alertBox.innerText = "SECURITY SHIELD ACTIVE - STREAM LOCK SYNCED";
                alertBox.className = "status-box status-good";
            }

            if(data.log_msg) {
                let term = document.getElementById('logTerminal');
                term.innerText += "\n" + data.log_msg;
                term.scrollTop = term.scrollHeight;
            }
        };

        function triggerRollback() {
            const passValue = document.getElementById('passKey').value;
            if (!passValue) return;
            let formData = new FormData();
            formData.append("passphrase", passValue);
            fetch('/api/rollback', { method: 'POST', body: formData });
        }
    </script>
</body>
</html>
)=====";











// --- Part 2: Backend Stream Processing Logic ---
void push_stream_frame(String logMessage) {
  if (!isStreamActive || !streamClient.connected()) {
    isStreamActive = false;
    return;
  }

  float raw_temp = (temprature_sens_read() - 32) / 1.8; 
  int current_stations = WiFi.softAPgetStationNum();
  size_t current_free_ram = heap_caps_get_free_size(MALLOC_CAP_INTERNAL);
  
  uint8_t current_hash[32];
  const esp_partition_t* running = esp_ota_get_running_partition();
  esp_partition_get_sha256(running, current_hash);

  String hex_hash = "";
  for (int i = 0; i < 32; i++) {
    if (current_hash[i] < 0x10) hex_hash += "0";
    hex_hash += String(current_hash[i], HEX);
  }

  // Inject structural hardware timestamps directly into JSON strings
  String json = "data: {";
  json += "\"compile_date\":\"" + String(SKETCH_COMPILE_DATE) + "\",";
  json += "\"compile_time\":\"" + String(SKETCH_COMPILE_TIME) + "\",";
  json += "\"temp\":" + String(raw_temp) + ",";
  json += "\"free_ram\":" + String(current_free_ram) + ",";
  json += "\"connections\":" + String(current_stations) + ",";
  json += "\"magnetic_events\":" + String(baseline.magnetic_tamper_count) + ",";
  json += "\"partition\":\"" + String(running->label) + "\",";
  json += "\"hash\":\"" + hex_hash + "\",";
  json += "\"compromised\":" + String(baseline.is_compromised ? "true" : "false") + ",";
  json += "\"reason\":\"" + baseline.attack_reason + "\"";

  if (logMessage.length() > 0) {
    json += ",\"log_msg\":\"[" + String(millis()/1000) + "s] " + logMessage + "\"";
  }
  json += "}\n\n";

  streamClient.print(json);
  streamClient.flush();
}

void handle_root() { server.send_P(200, "text/html", DASHBOARD_HTML); }


void handle_csv_export() {
  // 1. Calculate active telemetry parameters
  uint8_t current_hash[32];
  const esp_partition_t* running = esp_ota_get_running_partition();
  esp_partition_get_sha256(running, current_hash);
  
  String hex_hash = "";
  for (int i = 0; i < 32; i++) {
    if (current_hash[i] < 0x10) hex_hash += "0";
    hex_hash += String(current_hash[i], HEX);
  }

  // 2. Generate a standard plain-text CSV layout string
  String csv = "Forensic Field,Data Value,Mapping Block Address\n";
  csv += "Active Boot App Slot," + String(running->label) + ",0x" + String(running->address, HEX) + "\n";
  csv += "Active Secure Hash Footprint," + hex_hash + ",N/A\n";
  csv += "Upload Compilation Window," + String(SKETCH_COMPILE_DATE) + " " + String(SKETCH_COMPILE_TIME) + ",N/A\n";
  csv += "Available Device Memory Heap," + String(heap_caps_get_free_size(MALLOC_CAP_INTERNAL)) + " Bytes,N/A\n";
  csv += "Active Logged Client Nodes," + String(WiFi.softAPgetStationNum()) + ",N/A\n";

  // 3. Set the browser headers to force an instant text file download
  server.sendHeader("Content-Disposition", "attachment; filename=esp32_firmware_audit.csv");
  server.send(200, "text/csv", csv);
  
  push_stream_frame("FORENSIC DUMP -> Cryptographic state metadata exported to CSV spreadsheet file.");
}


void handle_stream_init() {
  streamClient = server.client();
  streamClient.println("HTTP/1.1 200 OK\nContent-Type: text/event-stream\nCache-Control: no-cache\nConnection: keep-alive\n");
  streamClient.flush();
  isStreamActive = true;
  push_stream_frame("Security telemetry stream link active.");
}

void handle_hardware_rollback() {
  String input_pass = server.arg("passphrase");
  if (input_pass == ROLLBACK_PASSWORD) {
    const esp_partition_t* rollback_part = esp_ota_get_next_update_partition(NULL);
    if (rollback_part != NULL) {
      push_stream_frame("WARNING: Switching active boot pointers to fallback slot...");
      delay(200);
      esp_ota_set_boot_partition(rollback_part);
      server.send(200, "text/plain", "Success");
      delay(1000);
      esp_restart();
    }
  } else {
    baseline.is_compromised = true;
    baseline.attack_reason = "BRUTE_FORCE_ATTEMPT";
    server.send(401, "text/plain", "Denied");
  }
}

void handle_captive_redirect() {
  server.sendHeader("Location", "http://192.168.4", true);
  server.send(302, "text/plain", ""); 
}

void setup() {
  Serial.begin(115200);
  WiFi.mode(WIFI_AP);
  WiFi.softAP(AP_SSID, AP_PASS);
  dnsServer.start(DNS_PORT, "*", IPAddress(192, 168, 4, 1));

  const esp_partition_t* running = esp_ota_get_running_partition();
  esp_partition_get_sha256(running, baseline.partition_hash);

  server.on("/api/export-csv", HTTP_GET, handle_csv_export);
  server.on("/", HTTP_GET, handle_root);
  server.on("/stream", HTTP_GET, handle_stream_init);
  server.on("/api/rollback", HTTP_POST, handle_hardware_rollback);
  server.onNotFound(handle_captive_redirect);
  server.begin();
}

void loop() {
  dnsServer.processNextRequest();
  server.handleClient();
  static unsigned long last_telemetry_time = 0;
  if (millis() - last_telemetry_time >= 1000) {
    last_telemetry_time = millis();
    if (isStreamActive) push_stream_frame("");
  }
}

