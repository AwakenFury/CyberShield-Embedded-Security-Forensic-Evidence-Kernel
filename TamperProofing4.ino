#include <WiFi.h>
#include <DNSServer.h>
#include <WebServer.h>
#include <esp_partition.h>
#include <esp_ota_ops.h>
#include <esp_heap_caps.h>
#include <LittleFS.h>

// Forward declaration so handle_view_code compiles cleanly!
extern WebServer server; 


// ==========================================
// FORWARD DECLARATIONS (Pivots code scope rules)
// ==========================================
void handle_root();
void handle_stream_init();
void handle_csv_export();
void handle_hardware_rollback();
void handle_captive_redirect();
void push_stream_frame(String logMessage);



void handle_view_code() {
  if (!server.hasArg("type")) {
    server.send(400, "text/plain", "Missing Parameter");
    return;
  }

  String fileTarget = server.arg("type");
  String path = (fileTarget == "stock") ? "/stock.txt" : "/current.txt";

  if (!LittleFS.exists(path)) {
    server.send(200, "text/plain", "// Forensics Error: Target source file [" + path + "] not found on flash partition memory.");
    return;
  }

  File codeFile = LittleFS.open(path, FILE_READ);
  server.streamFile(codeFile, "text/plain");
  codeFile.close();
}

// --- Core Internal ESP32 Temp Engine ---
#ifdef __cplusplus
extern "C" {
#endif
uint8_t temprature_sens_read(); 
#ifdef __cplusplus
}
#endif

// --- Configuration Settings ---
const char* AP_SSID = "UPDATED_SKETCH_SLOTB";
const char* AP_PASS = "FactorySecure123!"; 
const byte DNS_PORT = 53;
const char* ROLLBACK_PASSWORD = "AdminSuperSecretKey2026";
const float MAX_SAFE_TEMP = 80.0; 

// Capture macro constants generated by compiler on machine upload
const char* SKETCH_COMPILE_DATE = __DATE__;
const char* SKETCH_COMPILE_TIME = __TIME__;

struct SystemSnapshot {
  uint8_t partition_hash[32];
  volatile uint32_t magnetic_tamper_count;
  bool is_compromised;
  String attack_reason;
};

SystemSnapshot baseline;
DNSServer dnsServer;
WebServer server(80);

WiFiClient streamClient;
bool isStreamActive = false;



// --- Complete Side-by-Side Advanced Forensic Comparison View layout ---
const char DASHBOARD_HTML[] PROGMEM = R"=====(
<!DOCTYPE html>
<html lang="en">
<head>
    <meta charset="UTF-8">
    <meta name="viewport" content="width=device-width, initial-scale=1.0">
    <title>ESP32 Advanced Forensic System Core</title>
    <style>
        :root { --bg-main: #0f172a; --bg-card: #1e293b; --text-main: #f8fafc; --text-muted: #94a3b8; --border: #334155; --accent: #3b82f6; }
        body { font-family: -apple-system, sans-serif; background: var(--bg-main); color: var(--text-main); padding: 20px; margin: 0; }
        .container { max-width: 1200px; margin: 0 auto; }
        .card { background: var(--bg-card); padding: 20px; border-radius: 8px; margin-bottom: 15px; border: 1px solid var(--border); box-shadow: 0 4px 6px -1px rgba(0,0,0,0.1); }
        .status-box { padding: 12px; border-radius: 6px; font-weight: bold; text-align: center; font-size: 16px; margin-bottom: 10px; }
        .status-good { background: #065f46; color: #34d399; }
        .status-bad { background: #991b1b; color: #f87171; animation: pulse 1.5s infinite; }
        .grid-3 { display: grid; grid-template-columns: 1fr 1fr 1fr; gap: 15px; margin-bottom: 15px; }
        .grid-code { display: grid; grid-template-columns: 1fr 1fr; gap: 20px; }
        @media(max-width:900px){ .grid-3, .grid-code { grid-template-columns: 1fr; } }
        .metric-row { display: flex; justify-content: space-between; padding: 8px 0; border-bottom: 1px solid var(--border); font-size: 13px; }
        .metric-label { color: var(--text-muted); }
        .metric-value { font-family: monospace; font-weight: bold; }
        .code-title { font-weight: bold; color: #60a5fa; margin-bottom: 6px; font-size: 13px; display: flex; justify-content: space-between; }
        .code-view { background: #020617; border: 1px solid var(--border); border-radius: 6px; padding: 12px; font-family: 'Courier New', monospace; font-size: 11px; height: 400px; overflow: auto; color: #cbd5e1; white-space: pre; box-sizing: border-box; }
        .btn { display: block; width: 100%; background: var(--accent); color: white; border: none; padding: 10px; border-radius: 6px; font-weight: bold; cursor: pointer; text-align: center; box-sizing: border-box; text-decoration: none; font-size: 13px; }
        .btn:hover { background: #1d4ed8; }
        .btn-warn { background: #dc2626; }
        .btn-warn:hover { background: #b91c1c; }
        .btn-sec { background: #475569; }
        .input-field { width: 100%; padding: 8px; border-radius: 6px; border: 1px solid var(--border); background: #0f172a; color: white; box-sizing: border-box; font-family: monospace; text-align: center; }
        .terminal { background: #020617; border: 1px solid var(--border); border-radius: 6px; padding: 10px; font-family: monospace; font-size: 12px; height: 120px; overflow-y: auto; color: #38bdf8; white-space: pre-wrap; box-sizing: border-box; }
        @keyframes pulse { 0% { opacity: 1; } 50% { opacity: 0.5; } 100% { opacity: 1; } }
    </style>
</head>
<body>
    <div class="container">
        <!-- 1. System Health Status Panel -->
        <div id="statusAlert" class="status-box status-good">AWAITING SYSTEM SYNCHRONIZATION DATA...</div>

        <!-- 2. Hardware Live Diagnostic Grid -->
        <div class="grid-3">
            <div class="card">
                <h3>🌡️ Telemetry</h3>
                <div class="metric-row"><span class="metric-label">Silicon Core Temp</span><span id="tempVal" class="metric-value" style="color:#ef4444;">-- °C</span></div>
                <div class="metric-row"><span class="metric-label">Free System Heap</span><span id="ramVal" class="metric-value">-- bytes</span></div>
                <div class="metric-row"><span class="metric-label">Wireless Nodes</span><span id="connVal" class="metric-value">--</span></div>
            </div>
            <div class="card">
                <h3>🛡️ Security State</h3>
                <div class="metric-row"><span class="metric-label">Active Boot Slot</span><span id="partVal" class="metric-value" style="color:#34d399;">--</span></div>
                <div class="metric-row"><span class="metric-label">Hardware Hashes</span><span id="hashVal" class="metric-value">--</span></div>
                <div class="metric-row"><span class="metric-label">Magnetic Flags</span><span id="magVal" class="metric-value">0</span></div>
            </div>
            <div class="card">
                <h3>🔄 Recovery Vault</h3>
                <input type="password" id="passKey" class="input-field" placeholder="Verification code...">
                <button class="btn btn-warn" style="margin-top:8px;" onclick="triggerRollback()">Execute Partition Switch</button>
            </div>
        </div>

        <!-- 3. Dynamic Interactive Code Matrix Diff View -->
        <div class="card">
            <h3>🔬 Source Code Architecture Integrity (Volatile LittleFS Sandbox)</h3>
            <div class="grid-code">
                <div>
                    <div class="code-title">📦 Slot A (Immutable Baseline Sketch Source) <span style="color:#a7f3d0; font-family:monospace;">/stock.txt</span></div>
                    <div id="stockCodeBlock" class="code-view">Reading filesystem arrays...</div>
                </div>
                <div>
                    <div class="code-title">🚀 Current Partition (Active Compiled Script) <span style="color:#fde047; font-family:monospace;">/current.txt</span></div>
                    <div id="currentCodeBlock" class="code-view">Reading runtime memories...</div>
                </div>
            </div>
            <div style="display:flex; gap:10px; margin-top:15px;">
                <a href="/api/export-csv" class="btn btn-sec" style="max-width:250px;">📥 Export Allocation Log (.CSV)</a>
                <button class="btn btn-sec" style="max-width:250px;" onclick="window.print()">🖨️ Print System State Report</button>
            </div>
        </div>

        <!-- 4. Live Stream Output Logging Terminal -->
        <div class="card">
            <h3>📡 Stream Notification Logs</h3>
            <div id="logTerminal" class="terminal">Connecting to native stream vector channels...</div>
        </div>
    </div>

    <script>
        // Synchronously call internal endpoints to extract sketch files on browser connection
        function loadCodeFiles() {
            fetch('/api/view-code?type=stock')
                .then(res => res.text())
                .then(text => { document.getElementById('stockCodeBlock').innerText = text; })
                .catch(err => { document.getElementById('stockCodeBlock').innerText = "// Read Error accessing storage file system."; });

            fetch('/api/view-code?type=current')
                .then(res => res.text())
                .then(text => { document.getElementById('currentCodeBlock').innerText = text; })
                .catch(err => { document.getElementById('currentCodeBlock').innerText = "// Read Error accessing storage file system."; });
        }

        // Establish connection to Server-Sent Event Pipe channel
        const eventSource = new EventSource('/stream');

        eventSource.onmessage = function(event) {
            let data = JSON.parse(event.data);
            
            document.getElementById('tempVal').innerText = data.temp.toFixed(1) + " °C";
            document.getElementById('ramVal').innerText = data.free_ram.toLocaleString() + " bytes";
            document.getElementById('connVal').innerText = data.connections;
            document.getElementById('magVal').innerText = data.magnetic_events;
            document.getElementById('partVal').innerText = data.partition + " (Running Application)";
            document.getElementById('hashVal').innerText = data.hash.substring(0, 16) + "...";
            
            const alertBox = document.getElementById('statusAlert');
            if (data.compromised) {
                alertBox.innerText = "🚨 CRITICAL INTEGRITY ALERT: " + data.reason;
                alertBox.className = "status-box status-bad";
            } else {
                alertBox.innerText = "SECURITY SHIELD RUNNING - TELEMETRY LOCK ACTIVE (SYNC STATE GOOD)";
                alertBox.className = "status-box status-good";
            }

            if(data.log_msg) {
                let term = document.getElementById('logTerminal');
                term.innerText += "\n" + data.log_msg;
                term.scrollTop = term.scrollHeight;
            }
        };

        eventSource.onerror = function() {
            document.getElementById('logTerminal').innerText += "\n[System Tunnel] Stream link disconnected. Reconnecting...";
        };

        function triggerRollback() {
            const passValue = document.getElementById('passKey').value;
            if (!passValue) { alert("Enter verification code token."); return; }
            if (confirm("Confirm partition flip execution?")) {
                let formData = new FormData();
                formData.append("passphrase", passValue);
                fetch('/api/rollback', { method: 'POST', body: formData })
                .then(res => {
                    if(res.status === 200) {
                        alert("Rollback validated. Switching boot registers and executing chip hardware reset...");
                        window.location.reload();
                    } else {
                        alert("Authorization failure. Action logged.");
                    }
                });
            }
        }

        window.onload = function() {
            loadCodeFiles();
        };
    </script>
</body>
</html>
)=====";




void setup() {
  Serial.begin(115200);

  // 1. Initialize the persistent storage partition array
  if (!LittleFS.begin(true)) {
    Serial.println("LittleFS Mount Failed");
  }

  // Look inside your setup() function block:
  if (!LittleFS.exists("/stock.txt")) {
    File f = LittleFS.open("/stock.txt", FILE_WRITE);
    f.println("// STOCK FIRMWARE ARCHITECTURE BASELINE (SLOT A)");
    f.println("// Compiled: July 2026. Security signature state locked.");
    f.println("\nvoid setup() {\n  // Hardware structural parameters defined\n}");
    f.close();
  }
  
  if (!LittleFS.exists("/current.txt")) {
    File f = LittleFS.open("/current.txt", FILE_WRITE);
    f.println("// ACTIVE DEVELOPMENT ARDUINO IDE RUNNING SKETCH");
    f.println("// Target Variant: UPDATED_SKETCH_SLOTB");
    f.println("\nvoid loop() {\n  // Telemetry processing matrix running loops\n}");
    f.close();
  }


  // 3. Fire up the Wireless Network & Local DNS Gate
  WiFi.mode(WIFI_AP);
  WiFi.softAP(AP_SSID, AP_PASS);
  dnsServer.start(DNS_PORT, "*", IPAddress(192, 168, 4, 1));

  // 4. Capture initial clean boot fingerprint snapshot
  const esp_partition_t* running = esp_ota_get_running_partition();
  esp_partition_get_sha256(running, baseline.partition_hash);
  baseline.magnetic_tamper_count = 0;
  baseline.is_compromised = false;
  baseline.attack_reason = "";

  // 5. Mount Server Web & API Path Routers
  server.on("/", HTTP_GET, handle_root);
  server.on("/stream", HTTP_GET, handle_stream_init);
  server.on("/api/view-code", HTTP_GET, handle_view_code);
  server.on("/api/export-csv", HTTP_GET, handle_csv_export);
  server.on("/api/rollback", HTTP_POST, handle_hardware_rollback);
  server.onNotFound(handle_captive_redirect);
  
  server.begin();
  Serial.println("Zero-Library Secure Matrix Operating.");
}




void loop() {
  dnsServer.processNextRequest();
  server.handleClient();
  static unsigned long last_telemetry_time = 0;
  if (millis() - last_telemetry_time >= 1000) {
    last_telemetry_time = millis();
    if (isStreamActive) push_stream_frame("");
  }
}




void push_stream_frame(String logMessage) {
  if (!isStreamActive || !streamClient.connected()) {
    isStreamActive = false;
    return;
  }

  float raw_temp = (temprature_sens_read() - 32) / 1.8; 
  int current_stations = WiFi.softAPgetStationNum();
  size_t current_free_ram = heap_caps_get_free_size(MALLOC_CAP_INTERNAL);
  
  uint8_t current_hash[32];
  const esp_partition_t* running = esp_ota_get_running_partition();
  esp_partition_get_sha256(running, current_hash);

  String hex_hash = "";
  for (int i = 0; i < 32; i++) {
    if (current_hash[i] < 0x10) hex_hash += "0";
    hex_hash += String(current_hash[i], HEX);
  }

  // Inject structural hardware timestamps directly into JSON strings
  String json = "data: {";
  json += "\"compile_date\":\"" + String(SKETCH_COMPILE_DATE) + "\",";
  json += "\"compile_time\":\"" + String(SKETCH_COMPILE_TIME) + "\",";
  json += "\"temp\":" + String(raw_temp) + ",";
  json += "\"free_ram\":" + String(current_free_ram) + ",";
  json += "\"connections\":" + String(current_stations) + ",";
  json += "\"magnetic_events\":" + String(baseline.magnetic_tamper_count) + ",";
  json += "\"partition\":\"" + String(running->label) + "\",";
  json += "\"hash\":\"" + hex_hash + "\",";
  json += "\"compromised\":" + String(baseline.is_compromised ? "true" : "false") + ",";
  json += "\"reason\":\"" + baseline.attack_reason + "\"";

  if (logMessage.length() > 0) {
    json += ",\"log_msg\":\"[" + String(millis()/1000) + "s] " + logMessage + "\"";
  }
  json += "}\n\n";

  streamClient.print(json);
  streamClient.flush();
}

void handle_root() { server.send_P(200, "text/html", DASHBOARD_HTML); }


void handle_csv_export() {
  // 1. Calculate active telemetry parameters
  uint8_t current_hash[32];
  const esp_partition_t* running = esp_ota_get_running_partition();
  esp_partition_get_sha256(running, current_hash);
  
  String hex_hash = "";
  for (int i = 0; i < 32; i++) {
    if (current_hash[i] < 0x10) hex_hash += "0";
    hex_hash += String(current_hash[i], HEX);
  }

  // 2. Generate a standard plain-text CSV layout string
  String csv = "Forensic Field,Data Value,Mapping Block Address\n";
  csv += "Active Boot App Slot," + String(running->label) + ",0x" + String(running->address, HEX) + "\n";
  csv += "Active Secure Hash Footprint," + hex_hash + ",N/A\n";
  csv += "Upload Compilation Window," + String(SKETCH_COMPILE_DATE) + " " + String(SKETCH_COMPILE_TIME) + ",N/A\n";
  csv += "Available Device Memory Heap," + String(heap_caps_get_free_size(MALLOC_CAP_INTERNAL)) + " Bytes,N/A\n";
  csv += "Active Logged Client Nodes," + String(WiFi.softAPgetStationNum()) + ",N/A\n";

  // 3. Set the browser headers to force an instant text file download
  server.sendHeader("Content-Disposition", "attachment; filename=esp32_firmware_audit.csv");
  server.send(200, "text/csv", csv);
  
  push_stream_frame("FORENSIC DUMP -> Cryptographic state metadata exported to CSV spreadsheet file.");
}


void handle_stream_init() {
  streamClient = server.client();
  streamClient.println("HTTP/1.1 200 OK\nContent-Type: text/event-stream\nCache-Control: no-cache\nConnection: keep-alive\n");
  streamClient.flush();
  isStreamActive = true;
  push_stream_frame("Security telemetry stream link active.");
}

void handle_hardware_rollback() {
  String input_pass = server.arg("passphrase");
  if (input_pass == ROLLBACK_PASSWORD) {
    const esp_partition_t* rollback_part = esp_ota_get_next_update_partition(NULL);
    if (rollback_part != NULL) {
      push_stream_frame("WARNING: Switching active boot pointers to fallback slot...");
      delay(200);
      esp_ota_set_boot_partition(rollback_part);
      server.send(200, "text/plain", "Success");
      delay(1000);
      esp_restart();
    }
  } else {
    baseline.is_compromised = true;
    baseline.attack_reason = "BRUTE_FORCE_ATTEMPT";
    server.send(401, "text/plain", "Denied");
  }
}

void handle_captive_redirect() {
  server.sendHeader("Location", "http://192.168.4", true);
  server.send(302, "text/plain", ""); 
}


